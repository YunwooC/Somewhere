#include <U8g2lib.h>

U8G2_SSD1306_128X64_NONAME_F_HW_I2C u8g2(U8G2_R2, SCL, SDA, U8X8_PIN_NONE);  // High speed I2C

#define Ranch_1_Cloud_Day_width 128
#define Ranch_1_Cloud_Day_height 20
static const unsigned char Ranch_1_Cloud_Day_bits[] PROGMEM = {
   0xe0, 0xff, 0xff, 0xff, 0xff, 0x0f, 0x00, 0xfc, 0xff, 0xff, 0xff, 0xff,
   0xff, 0xff, 0xff, 0xff, 0x80, 0xff, 0xff, 0xff, 0xff, 0x01, 0x00, 0xf0,
   0xff, 0xff, 0xff, 0xff, 0xff, 0xff, 0xff, 0xff, 0x00, 0xff, 0xff, 0xff,
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   0xff, 0xff, 0xff, 0xff, 0xff, 0xff, 0xff, 0xff };

#define Ranch_1_Cloud_width 128
#define Ranch_1_Cloud_height 20
static const unsigned char Ranch_1_Cloud_bits[] PROGMEM = {
   0x1f, 0x00, 0x00, 0x00, 0x00, 0xf0, 0xff, 0x03, 0x00, 0x00, 0x00, 0x00,
   0x00, 0x00, 0x00, 0x00, 0x7f, 0x00, 0x00, 0x00, 0x00, 0xfe, 0xff, 0x0f,
   0x00, 0x00, 0x00, 0x00, 0x00, 0x00, 0x00, 0x00, 0xff, 0x00, 0x00, 0x00,
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   0x00, 0x00, 0x00, 0x00, 0x00, 0x00, 0x00, 0x00 };


#define Ranch_1_Sunny_Day_width 128
#define Ranch_1_Sunny_Day_height 20
static const unsigned char Ranch_1_Sunny_Day_bits[] PROGMEM = {
   0xff, 0xff, 0xff, 0xff, 0xff, 0xff, 0xff, 0xff, 0xff, 0xff, 0xff, 0xff,
   0xff, 0xff, 0xff, 0xff, 0xff, 0xff, 0xff, 0xff, 0xff, 0xff, 0xff, 0xff,
   0xff, 0xff, 0xff, 0xff, 0xff, 0xff, 0xff, 0xff, 0xff, 0xff, 0xff, 0xff,
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   0xff, 0xff, 0xff, 0xff, 0xff, 0xff, 0xff, 0xff };

#define Ranch_1_Sunny_width 128
#define Ranch_1_Sunny_height 20
static const unsigned char Ranch_1_Sunny_bits[] PROGMEM = {
   0x00, 0x00, 0x00, 0x00, 0x00, 0x00, 0x00, 0x00, 0x00, 0x00, 0x00, 0x00,
   0x00, 0x00, 0x00, 0x00, 0x00, 0x00, 0x00, 0x00, 0x00, 0x00, 0x00, 0x00,
   0x00, 0x00, 0x00, 0x00, 0x00, 0x00, 0x00, 0x00, 0x00, 0x00, 0x00, 0x00,
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   0x00, 0x00, 0x00, 0x00, 0x00, 0x00, 0x00, 0x00 };


#define Ranch_2_Mountains_Day_width 96
#define Ranch_2_Mountains_Day_height 21
static const unsigned char Ranch_2_Mountains_Day_bits[] PROGMEM = {
   0xff, 0xff, 0xff, 0xff, 0xff, 0xff, 0xff, 0xff, 0xff, 0xff, 0xff, 0xff,
   0xff, 0xff, 0xff, 0xff, 0xff, 0xff, 0xff, 0xff, 0xff, 0xff, 0xff, 0xff,
   0xff, 0xff, 0xff, 0xff, 0xff, 0xff, 0xff, 0xff, 0xff, 0xff, 0xff, 0xff,
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   0xff, 0xff, 0xff, 0xff, 0xf1, 0xff, 0xff, 0xff, 0xfc, 0xf1, 0xff, 0xff };

#define Ranch_2_Mountains_width 96
#define Ranch_2_Mountains_height 21
static const unsigned char Ranch_2_Mountains_bits[] PROGMEM = {
   0x00, 0x00, 0x00, 0x00, 0x00, 0x00, 0x00, 0x00, 0x00, 0x00, 0x00, 0x00,
   0x00, 0x00, 0x00, 0x00, 0x00, 0x00, 0x00, 0x00, 0x00, 0x00, 0x00, 0x00,
   0x00, 0x00, 0x00, 0x00, 0x00, 0x00, 0x00, 0x00, 0x00, 0x00, 0x00, 0x00,
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   0x00, 0x00, 0x00, 0x00, 0x0e, 0x00, 0x00, 0x00, 0x03, 0x0e, 0x00, 0x00 };


#define Ranch_2_Hills_Day_width 96
#define Ranch_2_Hills_Day_height 21
static const unsigned char Ranch_2_Hills_Day_bits[] PROGMEM = {
   0xff, 0xff, 0xff, 0xff, 0xff, 0xff, 0xff, 0xff, 0xff, 0xff, 0xff, 0xff,
   0xff, 0xff, 0xff, 0xff, 0xff, 0xff, 0xff, 0xff, 0xff, 0xff, 0xff, 0xff,
   0xff, 0xff, 0xff, 0xff, 0xff, 0xff, 0xff, 0xff, 0xff, 0xff, 0xff, 0xff,
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   0xff, 0xf7, 0xf8, 0xff, 0xfd, 0xfb, 0xff, 0xff, 0xff, 0xff, 0xff, 0xff };

#define Ranch_2_Hills_width 96
#define Ranch_2_Hills_height 21
static const unsigned char Ranch_2_Hills_bits[] PROGMEM= {
   0x00, 0x00, 0x00, 0x00, 0x00, 0x00, 0x00, 0x00, 0x00, 0x00, 0x00, 0x00,
   0x00, 0x00, 0x00, 0x00, 0x00, 0x00, 0x00, 0x00, 0x00, 0x00, 0x00, 0x00,
   0x00, 0x00, 0x00, 0x00, 0x00, 0x00, 0x00, 0x00, 0x00, 0x00, 0x00, 0x00,
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   0x00, 0x08, 0x07, 0x00, 0x02, 0x04, 0x00, 0x00, 0x00, 0x00, 0x00, 0x00 };


#define Ranch_3_Grassfield_Day_width 128
#define Ranch_3_Grassfield_Day_height 23
static const unsigned char Ranch_3_Grassfield_Day_bits[] PROGMEM = {
   0x43, 0xff, 0xe1, 0x3f, 0xf8, 0xe0, 0x1f, 0xff, 0x0f, 0xff, 0x8b, 0x07,
   0xff, 0xe1, 0x87, 0x7f, 0x71, 0x7e, 0xec, 0xc7, 0x3b, 0xde, 0xc1, 0xfc,
   0xc0, 0x3e, 0x58, 0x79, 0x0e, 0xe0, 0x79, 0x8f, 0x78, 0x0e, 0x4f, 0xf8,
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   0xff, 0xff, 0xff, 0xbf, 0xfd, 0xff, 0xff, 0xbb };

#define Ranch_3_Grassfield_width 128
#define Ranch_3_Grassfield_height 23
static const unsigned char Ranch_3_Grassfield_bits[] PROGMEM = {
   0xbc, 0x00, 0x1e, 0xc0, 0x07, 0x1f, 0xe0, 0x00, 0xf0, 0x00, 0x74, 0xf8,
   0x00, 0x1e, 0x78, 0x80, 0x8e, 0x81, 0x13, 0x38, 0xc4, 0x21, 0x3e, 0x03,
   0x3f, 0xc1, 0xa7, 0x86, 0xf1, 0x1f, 0x86, 0x70, 0x87, 0xf1, 0xb0, 0x07,
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   0x00, 0x00, 0x00, 0x40, 0x02, 0x00, 0x00, 0x44 };


#define Ranch_3_Road_Day_width 128
#define Ranch_3_Road_Day_height 23
static const unsigned char Ranch_3_Road_Day_bits[] PROGMEM = {
   0x00, 0x00, 0x00, 0x00, 0x00, 0x00, 0x00, 0x00, 0x00, 0x00, 0x00, 0x00,
   0x00, 0x00, 0x00, 0x00, 0xff, 0xff, 0xff, 0xff, 0xff, 0xff, 0xff, 0xff,
   0xff, 0xff, 0xff, 0xff, 0xff, 0xff, 0xff, 0xff, 0xff, 0xff, 0xff, 0xff,
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   0xff, 0xff, 0xff, 0xff, 0xff, 0xff, 0xff, 0xff };

#define Ranch_3_Road_width 128
#define Ranch_3_Road_height 23
static const unsigned char Ranch_3_Road_bits[] PROGMEM = {
   0xff, 0xff, 0xff, 0xff, 0xff, 0xff, 0xff, 0xff, 0xff, 0xff, 0xff, 0xff,
   0xff, 0xff, 0xff, 0xff, 0x00, 0x00, 0x00, 0x00, 0x00, 0x00, 0x00, 0x00,
   0x00, 0x00, 0x00, 0x00, 0x00, 0x00, 0x00, 0x00, 0x00, 0x00, 0x00, 0x00,
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   0x00, 0x00, 0x00, 0x00, 0x00, 0x00, 0x00, 0x00 };


#define Ranch_4_House_Day_width 32
#define Ranch_4_House_Day_height 21
static const unsigned char Ranch_4_House_Day_bits[] PROGMEM = {
   0x1f, 0x00, 0x00, 0xc0, 0x1f, 0x00, 0x00, 0xc0, 0x8f, 0xbe, 0xef, 0x9b,
   0x83, 0x7d, 0xdf, 0x97, 0x10, 0x00, 0x00, 0x00, 0x3c, 0xee, 0xfb, 0x3e,
   0x7e, 0xdc, 0xf7, 0x7d, 0xfe, 0x00, 0x00, 0x00, 0xfe, 0xf1, 0xbe, 0x77,
   0xfe, 0xe3, 0x7d, 0x6f, 0xee, 0x07, 0x00, 0x00, 0xce, 0x07, 0x00, 0x00,
   0x8e, 0x37, 0xff, 0xcf, 0x8e, 0x37, 0xff, 0xcf, 0x8e, 0x37, 0xff, 0xcf,
   0x8e, 0x37, 0xff, 0xcf, 0x8e, 0x37, 0xff, 0xcf, 0x8e, 0x37, 0x0f, 0xce,
   0x9e, 0x37, 0x0f, 0xce, 0xbe, 0x37, 0x0f, 0xce, 0xf9, 0x37, 0x0f, 0xce };

#define Ranch_4_House_width 32
#define Ranch_4_House_height 21
static const unsigned char Ranch_4_House_bits[] PROGMEM = {
   0xe0, 0xff, 0xff, 0x3f, 0xe0, 0xff, 0xff, 0x3f, 0x70, 0x41, 0x10, 0x64,
   0x7c, 0x82, 0x20, 0x68, 0xef, 0xff, 0xff, 0xff, 0xc3, 0x11, 0x04, 0xc1,
   0x81, 0x23, 0x08, 0x82, 0x01, 0xff, 0xff, 0xff, 0x01, 0x0e, 0x41, 0x88,
   0x01, 0x1c, 0x82, 0x90, 0x11, 0xf8, 0xff, 0xff, 0x31, 0xf8, 0xff, 0xff,
   0x71, 0xc8, 0x00, 0x30, 0x71, 0xc8, 0x00, 0x30, 0x71, 0xc8, 0x00, 0x30,
   0x71, 0xc8, 0x00, 0x30, 0x71, 0xc8, 0x00, 0x30, 0x71, 0xc8, 0xf0, 0x31,
   0x61, 0xc8, 0xf0, 0x31, 0x41, 0xc8, 0xf0, 0x31, 0x06, 0xc8, 0xf0, 0x31 };


#define Ranch_4_House2_Day_width 32
#define Ranch_4_House2_Day_height 21
static const unsigned char Ranch_4_House2_Day_bits[] PROGMEM = {
   0xff, 0xff, 0x03, 0xfe, 0xff, 0x1f, 0xf8, 0xff, 0xff, 0xc3, 0xff, 0xff,
   0xff, 0xf1, 0xff, 0x7f, 0xff, 0xec, 0xff, 0x81, 0x7f, 0xde, 0x07, 0xbe,
   0x3f, 0x1f, 0xf8, 0xbf, 0x7f, 0xb9, 0xff, 0x3f, 0x7f, 0xb9, 0x3f, 0xc0,
   0x7f, 0xb9, 0xc3, 0xff, 0x7f, 0x39, 0xfc, 0xff, 0x3f, 0xb9, 0xff, 0xff,
   0x8f, 0x3f, 0xff, 0x7f, 0xcf, 0xff, 0xfe, 0x87, 0xc7, 0xff, 0x0c, 0xf8,
   0xdf, 0xf0, 0xf2, 0xff, 0xdf, 0xf0, 0xfe, 0xff, 0xdf, 0xf0, 0x7e, 0x3c,
   0xdf, 0xf0, 0x7e, 0x3c, 0xdf, 0xf0, 0x7e, 0x3c, 0xdf, 0xf0, 0xfe, 0xff };

#define Ranch_4_House2_width 32
#define Ranch_4_House2_height 21
static const unsigned char Ranch_4_House2_bits[] PROGMEM = {
   0x00, 0x00, 0xfc, 0x01, 0x00, 0xe0, 0x07, 0x00, 0x00, 0x3c, 0x00, 0x00,
   0x00, 0x0e, 0x00, 0x80, 0x00, 0x13, 0x00, 0x7e, 0x80, 0x21, 0xf8, 0x41,
   0xc0, 0xe0, 0x07, 0x40, 0x80, 0x46, 0x00, 0xc0, 0x80, 0x46, 0xc0, 0x3f,
   0x80, 0x46, 0x3c, 0x00, 0x80, 0xc6, 0x03, 0x00, 0xc0, 0x46, 0x00, 0x00,
   0x70, 0xc0, 0x00, 0x80, 0x30, 0x00, 0x01, 0x78, 0x38, 0x00, 0xf3, 0x07,
   0x20, 0x0f, 0x0d, 0x00, 0x20, 0x0f, 0x01, 0x00, 0x20, 0x0f, 0x81, 0xc3,
   0x20, 0x0f, 0x81, 0xc3, 0x20, 0x0f, 0x81, 0xc3, 0x20, 0x0f, 0x01, 0x00 };


int button = 6;
char light = A6;
int num1;
int num2;
int num3;
int num4;

static void setup(void) {
  u8g2.begin();
  pinMode(button, INPUT);
  Serial.begin(9600);

  num1 = random(1, 3);
  num2 = random(1, 3);
  num3 = random(1, 3);
  num4 = random(1, 3);
}

void draw(int value) {
      if(num1 == 1){
        if(value < 100){
          u8g2.drawXBMP(0,0, Ranch_1_Cloud_width, Ranch_1_Cloud_height, Ranch_1_Cloud_bits);
        }
        else {
          u8g2.drawXBMP(0,0, Ranch_1_Cloud_Day_width, Ranch_1_Cloud_Day_height, Ranch_1_Cloud_Day_bits);
        }
      }
      else if(num1 == 2){
        
        if(value < 100){
          u8g2.drawXBMP(0,0, Ranch_1_Sunny_width, Ranch_1_Sunny_height, Ranch_1_Sunny_bits);
        }
        else {
          u8g2.drawXBMP(0,0, Ranch_1_Sunny_Day_width, Ranch_1_Sunny_Day_height, Ranch_1_Sunny_Day_bits);
        }
      }
      

      if(num2 == 1){
        if(value < 100){
          u8g2.drawXBMP(0,21, Ranch_2_Mountains_width, Ranch_2_Mountains_height, Ranch_2_Mountains_bits);
        }
        else {
          u8g2.drawXBMP(0,21, Ranch_2_Mountains_Day_width, Ranch_2_Mountains_Day_height, Ranch_2_Mountains_Day_bits);
        }
      }
      else if(num2 == 2) {
        if(value < 100){
          u8g2.drawXBMP(0,21, Ranch_2_Hills_width, Ranch_2_Hills_height, Ranch_2_Hills_bits);
        }
        else{
          u8g2.drawXBMP(0,21, Ranch_2_Hills_Day_width, Ranch_2_Hills_Day_height, Ranch_2_Hills_Day_bits);
        }
      }
      
      if(num3 == 1){
        if(value < 100){
          u8g2.drawXBMP(0,42, Ranch_3_Grassfield_width, Ranch_3_Grassfield_height, Ranch_3_Grassfield_bits);
        }
        else{
          u8g2.drawXBMP(0,42, Ranch_3_Grassfield_Day_width, Ranch_3_Grassfield_Day_height, Ranch_3_Grassfield_Day_bits);
        }
      }
      else if(num3 == 2) {
        if(value < 100){
          u8g2.drawXBMP(0,42, Ranch_3_Road_width, Ranch_3_Road_height, Ranch_3_Road_bits);
        }
        else {
          u8g2.drawXBMP(0,42, Ranch_3_Road_Day_width, Ranch_3_Road_Day_height, Ranch_3_Road_Day_bits);
        }
      }

      if(num4 == 1){
        if(value < 100){
          u8g2.drawXBMP(97,21, Ranch_4_House_width, Ranch_4_House_height, Ranch_4_House_bits);
        }
        else {
          u8g2.drawXBMP(97,21, Ranch_4_House_Day_width, Ranch_4_House_Day_height, Ranch_4_House_Day_bits);
        }
      }
      else if(num4 == 2) {
        if(value < 100){
          u8g2.drawXBMP(97,21, Ranch_4_House2_width, Ranch_4_House2_height, Ranch_4_House2_bits);
        }
        else{
          u8g2.drawXBMP(97,21, Ranch_4_House2_Day_width, Ranch_4_House2_Day_height, Ranch_4_House2_Day_bits);
        }
      }
}
  
void loop(void) {

  int value = analogRead(light);

  u8g2.firstPage();
  do {

    draw(value);
    
  } while(u8g2.nextPage());
  
  
  if(digitalRead(button) == HIGH){
     num1 = random(1, 3);
     num2 = random(1, 3);
     num3 = random(1, 3);
     num4 = random(1, 3);
  }

}
